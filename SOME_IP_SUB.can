/*@!Encoding:1252*/
includes
{
  
}

variables
{
  DWORD gMcGetter;          // getter method call
  DWORD dan_zone_limit;     // event call to get limit val
  DWORD resetFaultCodeSetter;   //method call to reset the fault
  DWORD setDangerLimitLow;      // method call to set 40 danger limit
  DWORD setDangerLimitHigh;     // method call to set 50 danger limit
  DWORD Current_dan_val_method;  // global to get g val
  DWORD aep = 0;            // application endpoint handle
  DWORD messageHandle = 0;  // handle of the created SOME/IP message
  BYTE payload[1];          // the message payload
  DWORD csi;                // consumed Service Instance handle
  DWORD ceg;                // consumed Eventgroup handle for tyre pressure event
  DWORD pre;                //Pressure danger zone
  DWORD cev;                // consumed Event handle
  DWORD dan_limit;          // danger limit 
  const int SERVICE_ID = 0x305f;  // Service id 
  const int EG1 = 1;              // Event Group
  const DWORD TYRE_PRESSURE_EVENT = 0x8001;  //Tyre pressure Id
  const DWORD DANGER_PRESSURE_EVENT = 0x8003;  // Danger limit id
  const DWORD ZONE_EVENT = 0x8005;        // Danger zone event
  const DWORD FieldGetterID = 31;         // Get Pressure id
  const DWORD ResetSetterID = 33;         // Reset Id
  const DWORD setDangerLimitlowID = 37; // 40 danger limit id
  const DWORD setDangerLimithighID = 40; // 50 danger limit id

  const int CLIENT_PORTNO = 30501; //port number

}

On start
{
  SomeIpSetVerbosity(3);  // Show information and warnings
  
  // initialize the payload.  No parameters are used in the GetFault() method though.
  payload[0] = 0xf;
   
  // open application endpoint
  aep = SomeIpOpenLocalApplicationEndpoint(17, 30501);
  CheckForSomeIpError();
  
  // create Service Instance
  csi = SomeIpCreateConsumedServiceInstance(aep,0x305f,1);
  CheckForSomeIpError();
  
  //Danger Limit Event
  dan_limit = SomeIpCreateEventConsumer(csi,0x8003,"getDangerLimitMethod");
  CheckForSomeIpError();
  
  //Danger Zone Event
  dan_zone_limit = SomeIpCreateEventConsumer(csi,0x8005,"OnZoneResponse");
  CheckForSomeIpError();
  
  
  //Pressure Event
  gMcGetter = SomeIpCreateMethodCall(csi,FieldGetterID,"OnFieldGetterResponse");
  CheckForSomeIpError();

  //RESET
  resetFaultCodeSetter = SomeIpCreateMethodCall(csi,ResetSetterID,"onFaultResetResponse");
  CheckForSomeIpError();
  
  //40
  setDangerLimitLow = SomeIpCreateMethodCall(csi,setDangerLimitlowID,"onDanFortyResponse");
  CheckForSomeIpError();
  
  //50
  setDangerLimitHigh = SomeIpCreateMethodCall(csi,setDangerLimithighID,"onDanFiftyResponse");
  CheckForSomeIpError();
  
  // G press
  Current_dan_val_method = SomeIpCreateMethodCall(csi,12,"OnDangerResponse");
  CheckForSomeIpError();
  
  //Works also without any Fibex/ARXML but only with SomeIpSetData and not SomeIpSetValueDWord (online help)
  SomeIpSetData(Current_dan_val_method,elCount(payload),payload);
  CheckForSomeIpError();
  
  // Subscribe to Eventgroup #1 for the event
  
  ceg = SomeIpAddConsumedEventGroup(csi,1);
  CheckForSomeIpError();

  // create Event Consumer
  cev = SomeIpCreateEventConsumer(csi,0x8001,"GetTyrePressureMethod");
  CheckForSomeIpError();

  // Enable multicast sending of events when 2 or more subscribers.
  SomeIpSetProperty(csi, "MulticastThreshold", 2);
}


  
/**********************************************************************
* Event handler for the tyrePressure event.
* Retrieves the current value and updates the panel display.
*********************************************************************/
void GetTyrePressureMethod(DWORD cevHandle, DWORD messageHandle)
{
    DWORD res;      // value of return parameter
    char data[1];

    // get the returned parameter values
    res = SomeIpGetData(messageHandle,elCount(data), data);
    CheckForSomeIpError();

    writeEx(0,1,"\nSUB-SOME/IP: tyrePressure event data received: %d ",data[0]);

    @SUB2::PressureDsp = data[0];
}

/**********************************************************************
* Gets the current value of the Danger zone event from the server
*********************************************************************/
void OnZoneResponse(DWORD eventHandle, DWORD messageHandle)
{
  DWORD res;        // value of return parameter
  char data[1];

  // get the returned parameter values
  res = SomeIpGetData(messageHandle,elCount(data), data);
  CheckForSomeIpError();

  writeEx(0,1,"\nDASH-SOME/IP: Danger zone() method return value:  %d ",data[0]);

  @SUB2::DangerZone= data[0];
}


/**********************************************************************
* Method that writes out the Fault response
*********************************************************************/
void onFaultResetResponse(dword methodCallHandle, dword messageResponseHandle )
{
    writeEx(0,1,"\nSUB2-SOME/IP: Reset Fault Code() method response received.");
}

/**********************************************************************
* Method to write out when 4 is pressed
*********************************************************************/
void onDanFortyResponse(dword methodCallHandle, dword messageResponseHandle )
{
    writeEx(0,1,"\nSUB2-SOME/IP: dan_limit 40 Code() method response received.");
}

/**********************************************************************
* Method to write out when 5 is pressed
*********************************************************************/
void onDanFiftyResponse(dword methodCallHandle, dword messageResponseHandle )
{
    writeEx(0,1,"\nSUB2-SOME/IP: dan_limit 50 Code() method response received.");
}

/**********************************************************************
* Event Handler to handle whent the reset button is pressed
*********************************************************************/
on sysvar_update SUB2::ResetFaultCode
{
  byte dataBuffer[1];
  if (@this == 1)     // prevent double-triggering with panel button controls
  {
      dataBuffer[0]=0;
      // set value of field content 
      SomeIpSetData(resetFaultCodeSetter,1,dataBuffer);
      CheckForSomeIpError();

      // call setter method
      SomeIpCallMethod(resetFaultCodeSetter);
      CheckForSomeIpError();
  }
}


/**********************************************************************
* Method to get the current Danger Limit Value
*********************************************************************/
void getDangerLimitMethod(DWORD danHandle, DWORD messageHandle)
{
    DWORD res;      // value of return parameter
    char data[1];

    // get the returned parameter values
    res = SomeIpGetData(messageHandle,elCount(data), data);
    CheckForSomeIpError();

    writeEx(0,1,"\nSUB2-SOME/IP: DangerPressure event data received: %d ",data[0]);

    @SUB2::DangerDsp = data[0];
}

/**********************************************************************
* When the r key is pressed the resetFaultCodeSetter Method is run
*********************************************************************/
on key 'r'
{
 byte dataBuffer[1];
      dataBuffer[0]=0;
  
  {
      // set value of field content 
      SomeIpSetData(resetFaultCodeSetter,1,dataBuffer);
      CheckForSomeIpError();

      // call setter method
      SomeIpCallMethod(resetFaultCodeSetter);
      CheckForSomeIpError();
  }
} 
/**********************************************************************
* When the key 4 is pressed the setDangerLimitLow method is run
*********************************************************************/    
on key '4'
{
  byte dataBuffer[1];
      dataBuffer[0]=0;
  
  {
      // set value of field content 
      SomeIpSetData(setDangerLimitLow,1,dataBuffer);
      CheckForSomeIpError();

      // call setter method
      SomeIpCallMethod(setDangerLimitLow);
      CheckForSomeIpError();
  }
}

/**********************************************************************
* When the key 5 is pressed the setDangerLimitHigh method is run
*********************************************************************/    
on key '5'
{
  byte dataBuffer[1];
      dataBuffer[0]=0;
  {
      // set value of field content 
      SomeIpSetData(setDangerLimitHigh,1,dataBuffer);
      CheckForSomeIpError();

      // call setter method
      SomeIpCallMethod(setDangerLimitHigh);
      CheckForSomeIpError();
  }
}
/**********************************************************************
* when G is pressed, Current_dan_val_method is triggered.
*********************************************************************/   
on key 'g'
{
    SomeIpCallMethod(Current_dan_val_method);
    CheckForSomeIpError();
}

/**********************************************************************
* Function to handle when the g button is pressed, it writes out the danger value in the
* write window
*********************************************************************/
void OnDangerResponse(dword methodCallHandle, dword messageResponseHandle )
{
  DWORD res;        // value of return parameter
  char data[1];
  

  // get the returned parameter values
  res = SomeIpGetData(messageResponseHandle,elCount(data), data);
  CheckForSomeIpError();

  writeEx(0,1,"\nDASH-SOME/IP: Get Danger limit() method return value:  %d ",data[0]);

  @SUB2::DangerDsp = data[0];
}

/**********************************************************************
* Generic function to catch any SOME/IP errors and log them to the
* Write window.
*********************************************************************/
  
void CheckForSomeIpError()
{
  char buffer[1024];
  // check if last function was executed correct
  if((SomeIpGetLastErrorText(elcount(buffer),buffer)) != 0)
  {
    writeEx(0,3,"\nSUB-SOME/IP: %s ",buffer);
  } 
  
}
